## boards/shields/numnumvum/Kconfig.defconfig
```kconfig
if SHIELD_NUMNUMVUM

config ZMK_KEYBOARD_NAME
    default "numnumvum 6x4 keypad"

endif
```

## boards/shields/numnumvum/Kconfig.shield
```kconfig
config SHIELD_NUMNUMVUM
    bool "numnumvum 6x4 keypad"
    depends on ZMK_KEYBOARD
```

## config/boards/shields/numnumvum/Kconfig.shield
```kconfig
config SHIELD_NUMNUMVUM
    bool "NumNumVum keyboard"
    depends on BOARD_NICE_NANO
```
