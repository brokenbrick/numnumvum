/ {
    numnumvum {
        compatible = "zmk,numnumvum";
        
        row-gpios = <&gpio0 10 GPIO_ACTIVE_HIGH>,
                    <&gpio0 9 GPIO_ACTIVE_HIGH>,
                    <&gpio0 8 GPIO_ACTIVE_HIGH>,
                    <&gpio0 4 GPIO_ACTIVE_HIGH>,
                    <&gpio0 11 GPIO_ACTIVE_HIGH>,
                    <&gpio0 0 GPIO_ACTIVE_HIGH>;

        col-gpios = <&gpio0 17 GPIO_ACTIVE_HIGH>,
                    <&gpio0 20 GPIO_ACTIVE_HIGH>,
                    <&gpio0 22 GPIO_ACTIVE_HIGH>,
                    <&gpio0 24 GPIO_ACTIVE_HIGH>;
    };
};